## conf/layer.conf
```bitbake
# We have a conf and classes directory, add to BBPATH
BBPATH .= ":${LAYERDIR}"

# We have recipes-* directories, add to BBFILES
BBFILES += "${LAYERDIR}/recipes-*/*/*.bb \
            ${LAYERDIR}/recipes-*/*/*.bbappend"

BBFILE_COLLECTIONS += "meta-embi"
BBFILE_PATTERN_meta-embi = "^${LAYERDIR}/"
BBFILE_PRIORITY_meta-embi = "25"

LAYERDEPENDS_meta-embi = "core"
LAYERSERIES_COMPAT_meta-embi = "mickledore"
```

## meta-embi-swupdate/conf/layer.conf
```bitbake
############################################################################
##
## This file is part of the meta-embi layer.
##
############################################################################

# We have a conf and classes directory, add to BBPATH
BBPATH .= ":${LAYERDIR}"

# We have recipes-* directories, add to BBFILES
BBFILES += "${LAYERDIR}/recipes-*/*/*.bb \
            ${LAYERDIR}/recipes-*/*/*.bbappend"

BBFILE_COLLECTIONS += "meta-embi-swupdate"
BBFILE_PATTERN_meta-embi-swupdate = "^${LAYERDIR}/"
BBFILE_PRIORITY_meta-embi-swupdate = "26"

LAYERDEPENDS_meta-embi-swupdate = "core"
LAYERSERIES_COMPAT_meta-embi-swupdate = "scarthgap"
```

## meta-embi-swupdate/wic/embi-swupdate-sdimage-rpi.wks
```
# short-description: Create Raspberry Pi SD card image
# long-description: Creates a partitioned SD card image for use with
# Raspberry Pi. Boot files are located in the first vfat partition.
# The rootfs partition automatically expands to fill the remaining space.

# ------------------------
# Boot partition (FAT32)
# ------------------------
# - Contains firmware, kernel, and bootloader files
# - Must be vfat so that the Pi bootloader can read it
# - Marked as active (bootable)
# - Fixed size: 100 MB (more than enough for kernel + DTBs)
part /boot \
    --source bootimg-partition \   # Populated with kernel + DTBs
    --ondisk mmcblk0 \             # Target device is the SD card
    --fstype=vfat \                # FAT required by RPi bootloader
    --label boot \                 # Partition label "boot"
    --active \                     # Mark partition bootable
    --align 4096 \                 # Align to 4096 sectors (~2MiB)
    --size 100                     # 100 MB minimum size

# ------------------------
# Root filesystem 1 (ext4)
# ------------------------
# - Contains the full Linux rootfs
# - Fixed size: 4096 MB (more than enough for later update)
part / \
    --source rootfs \              # Populated with IMAGE_ROOTFS
    --ondisk mmcblk0 \             # Same device (mmcblk0)
    --fstype=ext4 \                # Use ext4 for root filesystem
    --label RFS1 \                 # Partition label "RFS1"
    --align 4096 \                 # Align to 4096 sectors
    --size 4096                    # Ensure rootfs partition >= 4 GB

# ------------------------
# Root filesystem 2 (ext4)
# ------------------------
# - Fixed size: 4096 MB (more than enough for later update) 
part \
    --ondisk mmcblk0 \             # Same device (mmcblk0)
    --fstype=ext4 \                # Use ext4 for root filesystem
    --label RFS2 \                 # Partition label "RFS2"
    --align 4096 \                 # Align to 4096 sectors
    --size 4096                    # Ensure rootfs partition >= 4 GB

# ------------------------
# Config partition (ext4)
# ------------------------
# - Contains the persistant data
# - Minimum size 1024 MB (1 GB)
# - Will expand to fill entire SD card (via --resize)
part \
    --ondisk mmcblk0 \             # Same device (mmcblk0)
    --fstype=ext4 \                # Use ext4 for root filesystem
    --label config \               # Partition label "config"
    --align 4096 \                 # Align to 4096 sectors
    --size 2048 \                  # Ensure config partition >= 2 GB
    --resize                       # Expand to fill remaining space
```

## meta-embi/wic/embi-sdimage-rpi.wks
```
# short-description: Create Raspberry Pi SD card image
# long-description: Creates a partitioned SD card image for use with
# Raspberry Pi. Boot files are located in the first vfat partition.

# --------------------------------------------------
# Boot partition (/boot, FAT32)
# --------------------------------------------------
# - Contains firmware, kernel, and bootloader files
# - Must be FAT (vfat) because the Raspberry Pi firmware reads it directly
# - Marked active (bootable)
# - Fixed size: 100 MB, aligned to 4096 sectors (~2 MiB)
part /boot --source bootimg-partition --ondisk mmcblk0 --fstype=vfat --label boot --active --align 4096 --size 100

# --------------------------------------------------
# Root filesystem (/ , ext4)
# --------------------------------------------------
# - Main Linux root filesystem
# - Populated with IMAGE_ROOTFS at build time
# - Ext4 format, label "root"
# - Fixed size: 1 GB
part / --source rootfs --ondisk mmcblk0 --fstype=ext4 --label root --align 4096 --size 1024
```
